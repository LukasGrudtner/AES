#include "aes.h"


static void test_encrypt_cbc(void);
static void test_decrypt_cbc(void);
static void test_encrypt_ecb_verbose(void);

aes aes;

String converter_Uint_8_to_string(uint8_t *str){
    return String((char *)str);
}

uint8_t converter_string_to_Uint_8(String dataString){
  // TEM QUE FAZER PARA FUNCIONAR
}

String Uint8_t_to_Hex_String(uint8_t i[], int quant){
  String saida = "";
  for(int j = 0; j < quant; j++){
    char buffer [2];
    itoa (i[j],buffer,16);
    saida += buffer;
  }
  return saida;
}

void setup() {
  // put your setup code here, to run once:
  Serial.begin(9600);
}


void loop() {

  Serial.println("\n");

  //test_encrypt_ecb_verbose();


  
  uint8_t saida1[64], saida2[64];
  memset(saida1, 0, 64);
  memset(saida2, 0, 64);
  uint8_t entrada[] = {0x4c, 0x65, 0x61, 0x6e, 0x64, 0x72, 0x6f, 0x96, 0xe9, 0x3d, 0x7e, 0x11, 0x73, 0x93, 0x17, 0x2a,
                    0xae, 0x2d, 0x8a, 0x57, 0x1e, 0x03, 0xac, 0x9c, 0x9e, 0xb7, 0x6f, 0xac, 0x45, 0xaf, 0x8e, 0x51,
                    0x30, 0xc8, 0x1c, 0x46, 0xa3, 0x5c, 0xe4, 0x11, 0xe5, 0xfb, 0xc1, 0x19, 0x1a, 0x0a, 0x52, 0xef,
                    0xf6, 0x9f, 0x24, 0x45, 0xdf, 0x4f, 0x9b, 0x17, 0xad, 0x2b, 0x41, 0x7b, 0xe6, 0x6c, 0x37, 0x10 };
  // put your main code here, to run repeatedly:
  //Serial.print("TEXTO ENTRADA (D): ");
  //Serial.println((char*)entrada);
  
  String saidaString = test_encrypt_cbc(entrada, 128, saida1);

  Serial.print("ciphertext FORA:\n");
  phex2(saida1);
  
  //Hex_String_to_Uint8(saidaString, saidaHEX);
  //Serial.print("SAIDA1 (C): ");
  //Serial.println((char*)saida1);

  Serial.print("SAIDA STRING (C): ");
  Serial.println(saidaString);
  
  //entrada = saida1;
/*
  String saidaString2 = test_decrypt_cbc(entrada, 128, saida2);

  Serial.print("SAIDASTRING2 (D): ");
  Serial.println(saidaString2);
  Serial.println("");*/
  
  delay(5000);
}

static void phex2(uint8_t* str){
   unsigned char i;
    for (i = 0; i < 64; ++i){
        Serial.print(str[i]);
        Serial.print("|");
    }
    Serial.print("\n");
}

static void phex(uint8_t* str, int tamanho){

uint8_t len = 16;
if(tamanho == 128){
    uint8_t len = 16;
}else if(tamanho == 192){
    uint8_t len = 24;
}else if (tamanho == 256){
    uint8_t len = 32;
}

    unsigned char i;
    for (i = 0; i < len; ++i){
        Serial.print(str[i]);
        Serial.print("|");
    }
    Serial.print("\n");
}

static void test_encrypt_ecb_verbose(void)
{
    // Example of more verbose verification

    uint8_t i;

    // 128bit key
    uint8_t key[16] =        { (uint8_t) 0x2b, (uint8_t) 0x7e, (uint8_t) 0x15, (uint8_t) 0x16, (uint8_t) 0x28, (uint8_t) 0xae, (uint8_t) 0xd2, (uint8_t) 0xa6, (uint8_t) 0xab, (uint8_t) 0xf7, (uint8_t) 0x15, (uint8_t) 0x88, (uint8_t) 0x09, (uint8_t) 0xcf, (uint8_t) 0x4f, (uint8_t) 0x3c };
    // 512bit text
    uint8_t entrada[64] = { (uint8_t) 0x4c, (uint8_t) 0x65, (uint8_t) 0x61, (uint8_t) 0x6e, (uint8_t) 0x64, (uint8_t) 0x72, (uint8_t) 0x6f, (uint8_t) 0x96, (uint8_t) 0xe9, (uint8_t) 0x3d, (uint8_t) 0x7e, (uint8_t) 0x11, (uint8_t) 0x73, (uint8_t) 0x93, (uint8_t) 0x17, (uint8_t) 0x2a,
                               (uint8_t) 0xae, (uint8_t) 0x2d, (uint8_t) 0x8a, (uint8_t) 0x57, (uint8_t) 0x1e, (uint8_t) 0x03, (uint8_t) 0xac, (uint8_t) 0x9c, (uint8_t) 0x9e, (uint8_t) 0xb7, (uint8_t) 0x6f, (uint8_t) 0xac, (uint8_t) 0x45, (uint8_t) 0xaf, (uint8_t) 0x8e, (uint8_t) 0x51,
                               (uint8_t) 0x30, (uint8_t) 0xc8, (uint8_t) 0x1c, (uint8_t) 0x46, (uint8_t) 0xa3, (uint8_t) 0x5c, (uint8_t) 0xe4, (uint8_t) 0x11, (uint8_t) 0xe5, (uint8_t) 0xfb, (uint8_t) 0xc1, (uint8_t) 0x19, (uint8_t) 0x1a, (uint8_t) 0x0a, (uint8_t) 0x52, (uint8_t) 0xef,
                               (uint8_t) 0xf6, (uint8_t) 0x9f, (uint8_t) 0x24, (uint8_t) 0x45, (uint8_t) 0xdf, (uint8_t) 0x4f, (uint8_t) 0x9b, (uint8_t) 0x17, (uint8_t) 0xad, (uint8_t) 0x2b, (uint8_t) 0x41, (uint8_t) 0x7b, (uint8_t) 0xe6, (uint8_t) 0x6c, (uint8_t) 0x37, (uint8_t) 0x10 };

    // print text to encrypt, key and IV
    Serial.print("ECB encrypt verbose:\n\n");
    Serial.print("plain text:\n");
    for (i = (uint8_t) 0; i < (uint8_t) 4; ++i){
        phex(entrada + i * (uint8_t) 16, 128);
    }
     Serial.print("\n");

     Serial.print("key:\n");
      phex(key, 128);
     Serial.print("\n");

    // print the resulting cipher as 4 x 16 byte strings
     Serial.print("ciphertext:\n");
    
    struct AES_ctx ctx;
    aes.AES_init_ctx(&ctx, key);

    for (i = 0; i < 4; ++i)
    {
      aes.AES_ECB_encrypt(&ctx, entrada + (i * 16));
      phex(entrada + (i * 16), 128);
    }
     Serial.print("\n");
}



static String test_decrypt_cbc(uint8_t entrada3[], int tamanho, uint8_t* saida){
uint8_t key[] = {};
if(tamanho == 128){
    uint8_t key[] = { 0x2b, 0x7e, 0x15, 0x16, 0x28, 0xae, 0xd2, 0xa6, 0xab, 0xf7, 0x15, 0x88, 0x09, 0xcf, 0x4f, 0x3c };
}else if(tamanho == 192){
  uint8_t key[] = { 0x8e, 0x73, 0xb0, 0xf7, 0xda, 0x0e, 0x64, 0x52, 0xc8, 0x10, 0xf3, 0x2b, 0x80, 0x90, 0x79, 0xe5, 0x62, 0xf8, 0xea, 0xd2, 0x52, 0x2c, 0x6b, 0x7b };
}else if(256){
    uint8_t key[] = { 0x60, 0x3d, 0xeb, 0x10, 0x15, 0xca, 0x71, 0xbe, 0x2b, 0x73, 0xae, 0xf0, 0x85, 0x7d, 0x77, 0x81,
                      0x1f, 0x35, 0x2c, 0x07, 0x3b, 0x61, 0x08, 0xd7, 0x2d, 0x98, 0x10, 0xa3, 0x09, 0x14, 0xdf, 0xf4 };
}
    uint8_t iv[]  = { 0x00, 0x01, 0x02, 0x03, 0x04, 0x05, 0x06, 0x07, 0x08, 0x09, 0x0a, 0x0b, 0x0c, 0x0d, 0x0e, 0x0f };
    
    uint8_t cifrado1[]  = {0xd9, 0xb9, 0x87, 0xd5, 0xf4, 0x81, 0x55, 0x03, 0x3b, 0xa3,
                           0x34, 0xb1, 0xd0, 0x6f, 0x42, 0x44, 0xed, 0x03, 0xeb, 0xde,
                           0x5f, 0x53, 0x99, 0x8d, 0xf1, 0xee, 0xe5, 0x75, 0xb9, 0xca,
                           0xb5, 0x8d, 0x35, 0x2d, 0x9a, 0x15, 0xeb, 0x2c, 0x3d, 0xff,
                           0x8c, 0x5f, 0xe0, 0x3a, 0xb, 0xba, 0xd5, 0x9c, 0x66,  0x49, 
                           0x80, 0x8b, 0x40, 0x08, 0x1f, 0x7b, 0x9b, 0x3a, 0x25, 0xc8, 
                           0x37, 0x76, 0x8f, 0x3a};
    
    struct AES_ctx ctx;

    aes.AES_init_ctx_iv(&ctx, key, iv);
    aes.AES_CBC_decrypt_buffer(&ctx, entrada3, 64);
    //saida = (uint8_t*)entrada;

     Serial.print("DESIFRADO:\n");
      phex2(entrada3);

    return "";
}


static String test_encrypt_cbc(uint8_t entrada[], int tamanho, uint8_t* saida){
  uint8_t i, buf[64], buf2[64];
  memset(buf, 0, 64);
  memset(buf2, 0, 64);
  
  uint8_t key[] = {};
  uint8_t out[] = {};
  if(tamanho == 128){
    uint8_t key[] = { 0x2b, 0x7e, 0x15, 0x16, 0x28, 0xae, 0xd2, 0xa6, 0xab, 0xf7, 0x15, 0x88, 0x09, 0xcf, 0x4f, 0x3c };
  }else if(tamanho == 192){
    uint8_t key[] = { 0x8e, 0x73, 0xb0, 0xf7, 0xda, 0x0e, 0x64, 0x52, 0xc8, 0x10, 0xf3, 0x2b, 0x80, 0x90, 0x79, 0xe5, 
                      0x62, 0xf8, 0xea, 0xd2, 0x52, 0x2c, 0x6b, 0x7b };
  }else if(tamanho == 256){
    uint8_t key[] = { 0x60, 0x3d, 0xeb, 0x10, 0x15, 0xca, 0x71, 0xbe, 0x2b, 0x73, 0xae, 0xf0, 0x85, 0x7d, 0x77, 0x81,
                      0x1f, 0x35, 0x2c, 0x07, 0x3b, 0x61, 0x08, 0xd7, 0x2d, 0x98, 0x10, 0xa3, 0x09, 0x14, 0xdf, 0xf4 };
  }
    uint8_t iv[]  = { 0x00, 0x01, 0x02, 0x03, 0x04, 0x05, 0x06, 0x07, 0x08, 0x09, 0x0a, 0x0b, 0x0c, 0x0d, 0x0e, 0x0f };
    struct AES_ctx ctx;

    Serial.print("plain text:\n");
    
    phex2(entrada);
    
    Serial.print("\n");
    Serial.print("key:\n");
    phex(key, 128);
    Serial.print("\n");
    
    aes.AES_init_ctx_iv(&ctx, key, iv);
    aes.AES_CBC_encrypt_buffer(&ctx, entrada, 64);

    Serial.print("ciphertext:\n");
    phex2(entrada);

    saida = entrada;

    Serial.print("ciphertext DE:\n");
    phex2(saida);

    uint8_t teste[]  = {0xd9, 0xb9, 0x87, 0xd5, 0xf4, 0x81, 0x55, 0x03, 0x3b, 0xa3,
                           0x34, 0xb1, 0xd0, 0x6f, 0x42, 0x44, 0xed, 0x03, 0xeb, 0xde,
                           0x5f, 0x53, 0x99, 0x8d, 0xf1, 0xee, 0xe5, 0x75, 0xb9, 0xca,
                           0xb5, 0x8d, 0x35, 0x2d, 0x9a, 0x15, 0xeb, 0x2c, 0x3d, 0xff,
                           0x8c, 0x5f, 0xe0, 0x3a, 0xb, 0xba, 0xd5, 0x9c, 0x66,  0x49, 
                           0x80, 0x8b, 0x40, 0x08, 0x1f, 0x7b, 0x9b, 0x3a, 0x25, 0xc8, 
                           0x37, 0x76, 0x8f, 0x3a};

    test_decrypt_cbc(saida, 128, teste);

    return (Uint8_t_to_Hex_String(entrada, 64));
}


